## drivers/sensor/pmw3389/Kconfig
```kconfig
# Copyright (c) 2022 Team Spatzenhirn
# SPDX-License-Identifier: Apache-2.0

config PMW3389
	bool "PMW3389 motion sensor"
	help
	  Enable PMW3389 motion sensor.
```
